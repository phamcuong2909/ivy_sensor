/*
    Used library:
    NTP: https://github.com/PaulStoffregen/Time
*/

#include <ESP8266WiFi.h>
#include <string.h>
#include <SPI.h>
#include <Wire.h>
#include <Adafruit_GFX.h> 
#include <Adafruit_ST7735.h>
#include <DHT.h>
#include <TimeLib.h>
#include <WiFiUdp.h>
#include <PubSubClient.h>
#include <ESP8266WebServer.h>

#define DHTTYPE  DHT21
#define DHTPIN       D2

// Cấu hình cảm biến chuyển động, input được nối với chân D1
#define PIR_PIN D1

#define TFTCS       D0
#define TFTDC       D8
#define TFTRST      D4

Adafruit_ST7735   tft = Adafruit_ST7735(TFTCS, TFTDC, TFTRST);

// Cấu hình Wifi, sửa lại theo đúng mạng Wifi của bạn
const char* WIFI_SSID = "Sandiego";
const char* WIFI_PWD = "0988807067";

ESP8266WebServer server(80);

// Khai báo tần suất cập nhật dữ liệu là 10 phút 1 lần
const int UPDATE_INTERVAL = 5000; //1 * 60 * 1000;
unsigned long lastSentToServer = 0;

// Cấu hình thư viện NTP để lấy giờ hiện tại từ Internet
WiFiUDP Udp;
unsigned int localPort = 8888;  // local port to listen for UDP packets
time_t getNtpTime();
void sendNTPpacket(IPAddress &address);
static const char ntpServerName[] = "us.pool.ntp.org";
const int timeZone = 7;     // GMT của Việt Nam, GMT+7
time_t prevDisplay = 0; // when the digital clock was displayed

// Cấu hình cho giao thức MQTT
const char* clientId = "IvySensor1";
//const char* mqttServer = "broker.hivemq.com";
const char* mqttServer = "192.168.1.110";
const int mqttPort = 1883;
// Username và password để kết nối đến MQTT server nếu có 
// bật chế độ xác thực trên MQTT server
// Nếu không dùng thì cứ để vậy
const char* mqttUsername = "<MQTT_BROKER_USERNAME>";
const char* mqttPassword = "<MQTT_BROKER_PASSWORD>";

// Tên MQTT topic để gửi thông tin về nhiệt độ
const char* tempTopic = "/eHome/Bedroom1/Temperature";
// Tên MQTT topic để gửi thông tin về độ ẩm
const char* humidityTopic = "/eHome/Bedroom1/Humidity";
// Tên MQTT topic để gửi thông tin về ánh sáng
const char* brightnessTopic = "/eHome/Bedroom1/Brightness";
// Tên MQTT topic để gửi thông tin về chuyển động khi phát hiện
const char* motionTopic = "/eHome/Bedroom1/Motion";

boolean           blinkDot = false;
boolean           noData = true;
uint8_t           lastHour = 255;
uint8_t           lastMinute = 255;
uint8_t           lastHumidity = 255;
uint8_t           lastTemperature = 255;

// Các chuỗi lưu dữ liệu thu thập được để hiển thị trên màn hình Oled 
// và gửi về server qua giao thức MQTT
char temperatureMsg[10]; // nhiệt độ
char humidityMsg[10]; // độ ẩm (%)
char brightnessMsg[10]; // ánh sáng (%)
char motionMsg[5]; // chuyển động (1 hoặc 0)
float temperature, humidity, brightness;
boolean lastMotionStatus = false;

// Khởi tạo cảm biến độ ẩm nhiệt độ
DHT dht(DHTPIN, DHTTYPE, 15);

// Khởi tạo thư viện để kết nối wifi và MQTT server
WiFiClient wclient;
PubSubClient client(wclient);

static int16_t PROGMEM icon_sleep_1[] = {
0x0000, 0x0000, 0x0000, 0x0000, 0x0000, 0x0000, 0x0861, 0xEF7D, 0xEF7D, 0x0861, 0x0000, 0x0000, 0x0000, 0x0000, 0x0000, 0x0000,   // 0x0010 (16) pixels
0x0000, 0x0000, 0x0000, 0x0000, 0x0000, 0x0000, 0x7BEF, 0xFFDF, 0xFFDF, 0x7BEF, 0x0000, 0x0000, 0x0000, 0x0000, 0x0000, 0x0000,   // 0x0020 (32) pixels
0x0000, 0x0000, 0x0000, 0x0000, 0x0000, 0x0861, 0xEF5D, 0xFFDF, 0xFFDF, 0xEF5D, 0x0861, 0x0000, 0x0000, 0x0000, 0x0000, 0x0000,   // 0x0030 (48) pixels
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0x0000, 0x0000, 0x0861, 0x5AEB, 0x2945, 0x0000, 0x0000, 0x0000, 0x0000, 0x0000, 0x0000, 0x2945, 0x5AEB, 0x0861, 0x0000, 0x0000,   // 0x0100 (256) pixels
};

static int16_t PROGMEM icon_sleep_2[] = {
0x0000, 0x0000, 0x0000, 0x0000, 0x0000, 0x0000, 0x0861, 0xEF7D, 0xEF7D, 0x0861, 0x0000, 0x0000, 0x0000, 0x0000, 0x0000, 0x0000,   // 0x0010 (16) pixels
0x0000, 0x0000, 0x0000, 0x0000, 0x0000, 0x0000, 0x7BEF, 0xFFDF, 0xFFDF, 0x7BEF, 0x0000, 0x0000, 0x0000, 0x0000, 0x0000, 0x0000,   // 0x0020 (32) pixels
0x0000, 0x0000, 0x0000, 0x0000, 0x0000, 0x0861, 0xEF5D, 0xEF5D, 0xEF5D, 0xEF5D, 0x0861, 0x0000, 0x0000, 0x0000, 0x0000, 0x0000,   // 0x0030 (48) pixels
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0x0000, 0x0000, 0x0861, 0x5AEB, 0x2945, 0x0000, 0x0000, 0x0000, 0x0000, 0x0000, 0x0000, 0x2945, 0x5AEB, 0x0861, 0x0000, 0x0000,   // 0x0100 (256) pixels
};

static int16_t PROGMEM icon_humidity[] = {
0x0000, 0x0000, 0x0000, 0x0000, 0x0000, 0x0000, 0x2965, 0xDEFB, 0x2965, 0x0000, 0x0000, 0x0000, 0x0000, 0x0000, 0x0000, 0x0000,   // 0x0010 (16) pixels
0x0000, 0x0000, 0x0000, 0x0000, 0x0000, 0x2965, 0xEF5D, 0xFFDF, 0xEF5D, 0x2965, 0x0000, 0x0000, 0x0000, 0x0000, 0x0000, 0x0000,   // 0x0020 (32) pixels
0x0000, 0x0000, 0x0000, 0x0000, 0x2965, 0xEF5D, 0xFFDF, 0xFFDF, 0xFFDF, 0xEF5D, 0x2965, 0x0000, 0x0000, 0x0000, 0x0000, 0x0000,   // 0x0030 (48) pixels
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0x0000, 0x0000, 0x0000, 0x0000, 0x6B6D, 0xBDF7, 0xDEDB, 0xDEDB, 0xDEDB, 0xBDF7, 0x6B6D, 0x0000, 0x0000, 0x0000, 0x0000, 0x0000,   // 0x0100 (256) pixels
};

static int16_t PROGMEM icon_temperature[] = {
0x0000, 0x0000, 0x0000, 0x0000, 0x0000, 0x0000, 0x0000, 0x8C71, 0x8C71, 0x0000, 0x0000, 0x0000, 0x0000, 0x0000, 0x0000, 0x0000,   // 0x0010 (16) pixels
0x0000, 0x0000, 0x0000, 0x0000, 0x0000, 0x0000, 0x0000, 0xFFFF, 0xFFFF, 0x0000, 0x0000, 0x0000, 0x0000, 0x0000, 0x0000, 0x0000,   // 0x0020 (32) pixels
0x0000, 0x0000, 0x8C71, 0x9CD3, 0x18E3, 0x0000, 0x2965, 0xBDD7, 0xBDD7, 0x18E3, 0x0000, 0x18E3, 0x9CD3, 0x8C71, 0x0000, 0x0000,   // 0x0030 (48) pixels
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0x0000, 0x0000, 0x0000, 0x0000, 0x0000, 0x0000, 0x0000, 0x7BCF, 0x7BCF, 0x0000, 0x0000, 0x0000, 0x0000, 0x0000, 0x0000, 0x0000,   // 0x0100 (256) pixels
};

static int16_t PROGMEM icon_heart_1[] = {
0x0000, 0x2965, 0xBDF7, 0xFFFF, 0xFFFF, 0xFFFF, 0x9CF3, 0x0861, 0x0861, 0xAD75, 0xFFFF, 0xFFFF, 0xFFFF, 0xBDF7, 0x2965, 0x0000,   // 0x0010 (16) pixels
0x18E3, 0xEF5D, 0xFFDF, 0xFFDF, 0xFFDF, 0xFFDF, 0xFFDF, 0xCE79, 0xCE79, 0xFFDF, 0xFFDF, 0xFFDF, 0xFFDF, 0xFFDF, 0xEF5D, 0x18E3,   // 0x0020 (32) pixels
0x9CD3, 0xFFDF, 0xFFDF, 0xFFDF, 0xFFDF, 0xFFDF, 0xFFDF, 0xFFDF, 0xFFDF, 0xFFDF, 0xFFDF, 0xFFDF, 0xFFDF, 0xFFDF, 0xFFDF, 0x9CD3,   // 0x0030 (48) pixels
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0x0000, 0x0000, 0x0000, 0x0000, 0x0000, 0x0000, 0x2945, 0xB596, 0xB596, 0x2945, 0x0000, 0x0000, 0x0000, 0x0000, 0x0000, 0x0000,   // 0x0100 (256) pixels
};

static int16_t PROGMEM icon_heart_2[] = {
0x0000, 0x2965, 0xBDF7, 0xFFFF, 0xFFFF, 0xFFFF, 0x9CF3, 0x0861, 0x0861, 0xAD75, 0xFFFF, 0xFFFF, 0xFFFF, 0xBDF7, 0x2965, 0x0000,   // 0x0010 (16) pixels
0x18E3, 0xEF5D, 0xFFDF, 0xFFDF, 0xFFDF, 0xFFDF, 0xFFDF, 0xCE79, 0xCE79, 0xFFDF, 0xFFDF, 0xFFDF, 0xFFDF, 0xFFDF, 0xEF5D, 0x18E3,   // 0x0020 (32) pixels
0x9CD3, 0xFFDF, 0xEF5D, 0x5AEB, 0x39E7, 0x6B6D, 0xFFDF, 0xFFDF, 0xFFDF, 0xFFDF, 0x6B6D, 0x39E7, 0x5AEB, 0xEF5D, 0xFFDF, 0x9CD3,   // 0x0030 (48) pixels
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0x0000, 0x0000, 0x0000, 0x0000, 0x0000, 0x0000, 0x2945, 0xB596, 0xB596, 0x2945, 0x0000, 0x0000, 0x0000, 0x0000, 0x0000, 0x0000,   // 0x0100 (256) pixels
};

static int16_t PROGMEM icon_clock[] = {
0x0000, 0x0000, 0x0000, 0x0861, 0x8C71, 0xDEFB, 0xFFFF, 0xFFFF, 0xFFFF, 0xDEFB, 0x8C71, 0x0861, 0x0000, 0x0000, 0x0000, 0x0000,   // 0x0010 (16) pixels
0x0000, 0x0000, 0x4A69, 0xEF5D, 0xFFDF, 0xFFDF, 0xFFDF, 0xBDF7, 0xFFDF, 0xFFDF, 0xFFDF, 0xEF5D, 0x4A69, 0x0000, 0x0000, 0x0000,   // 0x0020 (32) pixels
0x0000, 0x4A69, 0xFFDF, 0xFFDF, 0xFFDF, 0xFFDF, 0xFFDF, 0xFFDF, 0xFFDF, 0xFFDF, 0xFFDF, 0xFFDF, 0xFFDF, 0x4A69, 0x0000, 0x0000,   // 0x0030 (48) pixels
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0x0000, 0x0000, 0x0000, 0x0000, 0x0000, 0x0000, 0x0000, 0x0000, 0x0000, 0x0000, 0x0000, 0x0000, 0x0000, 0x0000, 0x0000, 0x0000,   // 0x0100 (256) pixels
};

static int16_t PROGMEM icon_nodata[] = {
0x0000, 0x0000, 0x0000, 0x0000, 0x0000, 0x0000, 0x0000, 0x0000, 0x0000, 0x0000, 0x0000, 0x630C, 0xFFFF, 0xD69A, 0x0000, 0x0000,   // 0x0010 (16) pixels
0x0000, 0x0000, 0x0000, 0x0000, 0x0000, 0x0000, 0x3186, 0xBDF7, 0xEF7D, 0x4A69, 0x5AEB, 0xFFFF, 0xFFFF, 0xFFFF, 0x0000, 0x0000,   // 0x0020 (32) pixels
0x0000, 0x0000, 0x0000, 0x0000, 0x0000, 0x2965, 0xEF5D, 0xFFDF, 0xFFDF, 0xFFDF, 0xFFDF, 0xFFDF, 0xFFDF, 0x5AEB, 0x0000, 0x0000,   // 0x0030 (48) pixels
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0x0000, 0x0000, 0x0000, 0x0000, 0x0000, 0x0000, 0x0000, 0x0000, 0x18E3, 0x9CD3, 0xDEFB, 0xDEFB, 0xDEFB, 0x9CD3, 0x18E3, 0x0000,   // 0x0100 (256) pixels
};

void bitmap(int x, int y, int16_t *bitmap, int16_t w, int16_t h) {

  int16_t col, row;
  int16_t offset = 0;
  tft.setAddrWindow(x, y, x+w-1, y+h-1);

  for (row = 0; row < h; row++) 
  {
    for (col = 0; col < w; col++) {
        tft.pushColor(pgm_read_word(bitmap+offset));
        offset++;
      }


    }
}

void setup(void)
{
  Serial.begin(115200);

  // Khởi tạo thư viện cho cảm biến DHT
  Wire.begin();
  dht.begin();


  // Init thư viện cho màn hình TFT
  //tft.initR(INITR_REDTAB);
  tft.initR(INITR_BLACKTAB);   // ST7735S chip, black tab
  tft.setRotation(1);

  //WiFi.setPhyMode(WIFI_PHY_MODE_11G); 
  WiFi.setOutputPower(7);

  WiFi.begin(WIFI_SSID, WIFI_PWD);

  int counter = 0;
  while (WiFi.status() != WL_CONNECTED) {
    delay(500);
    Serial.print(".");
  }

  Serial.print("IP number assigned by DHCP is ");
  Serial.println(WiFi.localIP());

  // Kết nối tới MQTT server
  client.setServer(mqttServer, mqttPort);
  // Đăng ký hàm sẽ xử lý khi có dữ liệu từ MQTT server gửi về
  client.setCallback(onMQTTMessageReceived);
  
  Serial.println("Starting UDP");
  Udp.begin(localPort);
  Serial.print("Local port: ");
  Serial.println(Udp.localPort());
  Serial.println("waiting for sync");
  setSyncProvider(getNtpTime);
  setSyncInterval(300);

  drawIdleScreen();

  launchWeb(0);
}

int stringToInt(String string)
{
  int value = 0;
  for (int i=0; i < string.length() ; i++)
  {
    char c = string[i];
    if (c >= '0' && c <= '9')
    { 
      value = (10 * value) + (c - '0');
    }
  }
  return value;
}

uint32_t stringToTime(String string)
{
  uint32_t pctime = 0;
  for (int i=0; i < string.length() ; i++)
  {
    char c = string[i];
    if (c >= '0' && c <= '9')
    { 
      pctime = (10 * pctime) + (c - '0');
    }
  }
  return pctime;
}

bool printTwoDigitsByZero(int digits, uint8_t *last)
{
  if (*last == digits)
  {
    return false;
  }

  if (digits < 10)
  {
    tft.print("0");
  }

  tft.print(digits);

  *last = digits;

  return true;
}

bool printTwoDigitsBySpace(int digits, uint8_t *last)
{
  if (*last == digits)
  {
    return false;
  }

  if (digits < 10)
  {
    tft.print(" ");
  }

  tft.print(digits);

  *last = digits;

  return true;
}

// Cztery cyfry bez zera (cache)
bool printFourDigitsByZero(int digits, uint16_t *last)
{
  if (*last == digits)
  {
    return false;
  }

  if (digits < 10) 
  {
    tft.print("   ");
  } else
  if (digits < 100) 
  {
    tft.print("  ");
  } else
  if (digits < 1000) 
  {
    tft.print(" ");
  }

  tft.print(digits);

  *last = digits;

  return true;
}

void clearScreen()
{
  tft.fillScreen(ST7735_BLACK);
  tft.setTextColor(ST7735_WHITE, ST7735_BLACK);

  lastHour = 255;
  lastMinute = 255;
  lastHumidity = 255;
  lastTemperature = 255;
}

void drawIdleScreen()
{
  clearScreen();

  bitmap(19, 87, icon_humidity, 16, 16);
  bitmap(18, 107, icon_temperature, 16, 16);
}

void updateSecDot(unsigned long drawTime, int fontsize, int x, int y, uint16_t color)
{
  if (drawTime < 1000)
  {
    unsigned long diffTime = 1000 - drawTime;
    delay(diffTime);
  }

  tft.setTextSize(fontsize);
  tft.setCursor(x, y);
  tft.setTextColor(color, ST7735_BLACK);

  if (blinkDot)
  {
     tft.print(':');
  } else
  {
    tft.print(' ');
  }

  tft.setTextSize(1);
  tft.setCursor(0, 120);

  if (noData)
  {
    if (blinkDot)
    {
      bitmap(115, 95, icon_nodata, 16, 16);
    } else
    {
      tft.fillRect(115, 95, 16, 16, ST7735_BLACK);
    }
  } else
  {
    if (blinkDot)
    {
      bitmap(115, 95, icon_heart_1, 16, 16);
    } else
    {
      bitmap(115, 95, icon_heart_2, 16, 16);
    }
  }

  blinkDot = !blinkDot;
}

void updateIdleScreen()
{
  unsigned long startDrawTime = millis();

  /*********************************
   * Display current date and time
   *********************************/

   if (timeStatus() != timeNotSet) {
    if (now() != prevDisplay) { //update the display only if time has changed
      prevDisplay = now();

      // current time
      tft.setTextSize(4);
      tft.setTextColor(ST7735_CYAN, ST7735_BLACK);
    
      tft.setCursor(20, 5);
      printTwoDigitsByZero(hour(), &lastHour);
      tft.setCursor(68, 5);
      tft.print(":");
      tft.setCursor(92, 5);
      printTwoDigitsByZero(minute(), &lastMinute);
    
      int sx = 21;
      int sy = 40;
      int sec = second()*2;
      int black = (60-sec)*2;
      tft.fillRect(sx, sy, sec, 3, ST7735_YELLOW);
      tft.fillRect(sx+sec, sy, black, 3, ST7735_BLACK);

      // current date
      tft.setTextSize(2);
      tft.setTextColor(ST7735_WHITE, ST7735_BLACK);
      tft.setCursor(19, 50);
      tft.print(day());
      tft.print("/");
      tft.print(month());
      tft.print("/");
      tft.print(year());

      // current week day
      tft.setTextColor(ST7735_WHITE, ST7735_BLACK);
      tft.setCursor(65, 70);
      tft.setTextSize(1);
    
      switch (weekday())
      {
        case 1: tft.print("      SUN"); break;
        case 2: tft.print("      MON"); break;
        case 3: tft.print("      TUE"); break;
        case 4: tft.print("      WED"); break;
        case 5: tft.print("      THU"); break;
        case 6: tft.print("      FRI"); break;
        case 7: tft.print("      SAT"); break;
      }
    }
  }  

  /*******************************************
   * Display current temperature and humidity
   ******************************************/
   
  humidity = dht.readHumidity();
  dtostrf(humidity, 4, 1, humidityMsg);
  temperature = dht.readTemperature();
  dtostrf(temperature, 4, 1, temperatureMsg);
  brightness = analogRead(A0)*100/1024;
  dtostrf(brightness, 4, 1, brightnessMsg);

  if (!isnan(temperature) && !isnan(humidity))
  {

    tft.setTextSize(2);

    tft.setCursor(40, 87);
    tft.setTextColor(ST7735_CYAN, ST7735_BLACK);

    tft.print(humidityMsg);
    tft.print("%");

    tft.setCursor(40, 108);
    tft.setTextColor(ST7735_MAGENTA, ST7735_BLACK);

    tft.print(temperatureMsg);
    tft.print("'C");
  }

  updateSecDot(millis() - (startDrawTime), 4, 68, 5, ST7735_CYAN);
}

void loop() 
{
  if (!client.connected()) {
    if (client.connect(clientId, mqttUsername, mqttPassword)) {
      Serial.println("MQTT server connected");
      client.loop();
    } else {
      Serial.print("failed, rc=");
      Serial.print(client.state());
    }
  } else {
    client.loop();  
  }

  boolean currentMotionStatus = digitalRead(PIR_PIN);
  
  if (currentMotionStatus != lastMotionStatus) {
    lastMotionStatus = currentMotionStatus;
    if (currentMotionStatus) {
      Serial.println("Motion detected");
    }
    client.publish(motionTopic, "1");
  }

  updateIdleScreen();
  server.handleClient();
  unsigned long currentMillis = millis();

  if (lastSentToServer == 0 || currentMillis - lastSentToServer >= UPDATE_INTERVAL) {
    // Update sensor information to MQTT server
    client.publish(humidityTopic, humidityMsg);
    delay(200);
    client.publish(tempTopic, temperatureMsg);
    delay(200);
    client.publish(brightnessTopic, brightnessMsg);
    Serial.print("Do sang (%) hien tai: "); Serial.println(brightness);

    // save the last time sent data to server
    lastSentToServer = currentMillis;
  }
}

/*-------- NTP code ----------*/

const int NTP_PACKET_SIZE = 48; // NTP time is in the first 48 bytes of message
byte packetBuffer[NTP_PACKET_SIZE]; //buffer to hold incoming & outgoing packets

time_t getNtpTime()
{
  IPAddress ntpServerIP; // NTP server's ip address

  while (Udp.parsePacket() > 0) ; // discard any previously received packets
  Serial.println("Transmit NTP Request");
  // get a random server from the pool
  WiFi.hostByName(ntpServerName, ntpServerIP);
  Serial.print(ntpServerName);
  Serial.print(": ");
  Serial.println(ntpServerIP);
  sendNTPpacket(ntpServerIP);
  uint32_t beginWait = millis();
  while (millis() - beginWait < 1500) {
    int size = Udp.parsePacket();
    if (size >= NTP_PACKET_SIZE) {
      Serial.println("Receive NTP Response");
      Udp.read(packetBuffer, NTP_PACKET_SIZE);  // read packet into the buffer
      unsigned long secsSince1900;
      // convert four bytes starting at location 40 to a long integer
      secsSince1900 =  (unsigned long)packetBuffer[40] << 24;
      secsSince1900 |= (unsigned long)packetBuffer[41] << 16;
      secsSince1900 |= (unsigned long)packetBuffer[42] << 8;
      secsSince1900 |= (unsigned long)packetBuffer[43];
      return secsSince1900 - 2208988800UL + timeZone * SECS_PER_HOUR;
    }
  }
  Serial.println("No NTP Response :-(");
  return 0; // return 0 if unable to get the time
}

// send an NTP request to the time server at the given address
void sendNTPpacket(IPAddress &address)
{
  // set all bytes in the buffer to 0
  memset(packetBuffer, 0, NTP_PACKET_SIZE);
  // Initialize values needed to form NTP request
  // (see URL above for details on the packets)
  packetBuffer[0] = 0b11100011;   // LI, Version, Mode
  packetBuffer[1] = 0;     // Stratum, or type of clock
  packetBuffer[2] = 6;     // Polling Interval
  packetBuffer[3] = 0xEC;  // Peer Clock Precision
  // 8 bytes of zero for Root Delay & Root Dispersion
  packetBuffer[12] = 49;
  packetBuffer[13] = 0x4E;
  packetBuffer[14] = 49;
  packetBuffer[15] = 52;
  // all NTP fields have been given values, now
  // you can send a packet requesting a timestamp:
  Udp.beginPacket(address, 123); //NTP requests are to port 123
  Udp.write(packetBuffer, NTP_PACKET_SIZE);
  Udp.endPacket();
}

/*---------------------- Web server setup ----------------------*/

void launchWeb(int webtype) {
  if (webtype == 0) {
    server.on("/", []() {
      IPAddress ip = WiFi.localIP();
      String ipStr = String(ip[0]) + '.' + String(ip[1]) + '.' + String(ip[2]) + '.' + String(ip[3]);
      server.send(200, "application/json", "{\"IP\":\"" + ipStr + "\"}");
    });
    server.on("/cleareeprom", []() {
      String content;
      content = "<!DOCTYPE HTML>\r\n<html>";
      content += "<p>Clearing the EEPROM</p></html>";
      server.send(200, "text/html", content);
      Serial.println("clearing eeprom");
      //for (int i = 0; i < 96; ++i) { EEPROM.write(i, 0); }
      //EEPROM.commit();
    });
  }
  // Start the server
  server.begin();
  Serial.println("Server started"); 
}

void onMQTTMessageReceived(char* topic, byte* payload, unsigned int length) {
  Serial.print("Nhan duoc du lieu tu MQTT server [");
  Serial.print(topic);
  Serial.print("] ");
  for (int i = 0; i < length; i++) {
    Serial.print((char)payload[i]);
  }
  Serial.println();
}
