#include <ESP8266WiFi.h>
#include <string.h>
#include <Wire.h>
#include <DHT.h>
#include <TimeLib.h>
#include <WiFiUdp.h>
#include <Adafruit_GFX.h> 
#include <Adafruit_ST7735.h>
#include <PubSubClient.h>

// Khai báo các chân nối với cảm biến
#define DHTTYPE  DHT22
#define DHTPIN   D3
#define PIR_PIN D1

// Khai báo các chân điều khiển LCD SPI
#define TFTCS       D0
#define TFTDC       D8
#define TFTRST      D4

const int UPDATE_INTERVAL = 5000; // Tần suất cập nhật dữ liệu
unsigned long lastSensorUpdateTime = 0; // Lưu thời gian lần cuối cùng cập nhật dữ liệu sensor

float temperature, humidity, lightStatus;
char temperatureMsg[10]; // nhiệt độ
char humidityMsg[10]; // độ ẩm (%)
char lightStatusMsg[10]; // ánh sáng (%)
char motionMsg[5]; // chuyển động (1 hoặc 0)

boolean lastMotionStatus = false;

// Khởi tạo cảm biến độ ẩm nhiệt độ
DHT dht(DHTPIN, DHTTYPE, 15);

// Cấu hình Wifi, sửa lại theo đúng mạng Wifi của bạn
const char* WIFI_SSID = "your_wifi_network";
const char* WIFI_PWD = "your_wifi_password";

// Cấu hình thư viện NTP để lấy giờ hiện tại từ Internet
WiFiUDP Udp;
unsigned int localPort = 8888;  // local port to listen for UDP packets
time_t getNtpTime();
void sendNTPpacket(IPAddress &address);
static const char ntpServerName[] = "us.pool.ntp.org";
const int timeZone = 7; // GMT của Việt Nam, GMT+7
time_t lastClockUpdateTime = 0; // Lưu thời gian lần cuối cập nhật đồng hồ

// Khai báo thiết lập màn hình LCD
Adafruit_ST7735 tft = Adafruit_ST7735(TFTCS, TFTDC, TFTRST);

// Khai báo các icon để hiển thị trên màn hình LCD
static int16_t PROGMEM icon_humidity[] = {
0x0000, 0x0000, 0x0000, 0x0000, 0x0000, 0x0000, 0x2965, 0xDEFB, 0x2965, 0x0000, 0x0000, 0x0000, 0x0000, 0x0000, 0x0000, 0x0000,   // 0x0010 (16) pixels
0x0000, 0x0000, 0x0000, 0x0000, 0x0000, 0x2965, 0xEF5D, 0xFFDF, 0xEF5D, 0x2965, 0x0000, 0x0000, 0x0000, 0x0000, 0x0000, 0x0000,   // 0x0020 (32) pixels
0x0000, 0x0000, 0x0000, 0x0000, 0x2965, 0xEF5D, 0xFFDF, 0xFFDF, 0xFFDF, 0xEF5D, 0x2965, 0x0000, 0x0000, 0x0000, 0x0000, 0x0000,   // 0x0030 (48) pixels
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0x0000, 0x0000, 0x0000, 0x0000, 0x6B6D, 0xBDF7, 0xDEDB, 0xDEDB, 0xDEDB, 0xBDF7, 0x6B6D, 0x0000, 0x0000, 0x0000, 0x0000, 0x0000,   // 0x0100 (256) pixels
};

static int16_t PROGMEM icon_temperature[] = {
0x0000, 0x0000, 0x0000, 0x0000, 0x0000, 0x0000, 0x0000, 0x8C71, 0x8C71, 0x0000, 0x0000, 0x0000, 0x0000, 0x0000, 0x0000, 0x0000,   // 0x0010 (16) pixels
0x0000, 0x0000, 0x0000, 0x0000, 0x0000, 0x0000, 0x0000, 0xFFFF, 0xFFFF, 0x0000, 0x0000, 0x0000, 0x0000, 0x0000, 0x0000, 0x0000,   // 0x0020 (32) pixels
0x0000, 0x0000, 0x8C71, 0x9CD3, 0x18E3, 0x0000, 0x2965, 0xBDD7, 0xBDD7, 0x18E3, 0x0000, 0x18E3, 0x9CD3, 0x8C71, 0x0000, 0x0000,   // 0x0030 (48) pixels
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0x0000, 0x0000, 0x0000, 0x0000, 0x0000, 0x0000, 0x0000, 0x7BCF, 0x7BCF, 0x0000, 0x0000, 0x0000, 0x0000, 0x0000, 0x0000, 0x0000,   // 0x0100 (256) pixels
};

static int16_t PROGMEM icon_alarm[] = {
  0x8410, 0x8410, 0x8410, 0x8410, 0x8410, 0x8410, 0x83ef, 0x7c10, 0x83ef, 0x83cf, 0x83ef, 0x7c10, 0x7c10, 0x83ef, 0x83cf, 0x83ef, 0x7c10, 0x83ef, 0x8410, 0x8410, 0x8410, 0x8410, 0x8410, 0x8410, 
  0x8410, 0x8410, 0x8410, 0x8410, 0x83ef, 0x7c10, 0x83ef, 0x83ef, 0x7c10, 0x7c30, 0x7c10, 0x83cf, 0x83cf, 0x7c10, 0x7c30, 0x7c30, 0x83ef, 0x83ef, 0x7c10, 0x83ef, 0x8410, 0x8410, 0x8410, 0x8410, 
  0x8410, 0x8410, 0x8410, 0x83ef, 0x7c10, 0x83ef, 0x83ef, 0x7c30, 0x934d, 0xc1c7, 0xd8e3, 0xe8a2, 0xe8a2, 0xe0e3, 0xc1a6, 0x9b2c, 0x7c30, 0x7c10, 0x83ef, 0x7c10, 0x83ef, 0x8410, 0x8410, 0x8410, 
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  0x8410, 0x8410, 0x8410, 0x8410, 0x8410, 0x8410, 0x8410, 0x8410, 0x8410, 0x8410, 0x8410, 0x8410, 0x8410, 0x8410, 0x8410, 0x8410, 0x8410, 0x8410, 0x8410, 0x8410, 0x8410, 0x8410, 0x8410, 0x8410
};

static int16_t PROGMEM icon_clock[] = {
0x0000, 0x0000, 0x0000, 0x0861, 0x8C71, 0xDEFB, 0xFFFF, 0xFFFF, 0xFFFF, 0xDEFB, 0x8C71, 0x0861, 0x0000, 0x0000, 0x0000, 0x0000,   // 0x0010 (16) pixels
0x0000, 0x0000, 0x4A69, 0xEF5D, 0xFFDF, 0xFFDF, 0xFFDF, 0xBDF7, 0xFFDF, 0xFFDF, 0xFFDF, 0xEF5D, 0x4A69, 0x0000, 0x0000, 0x0000,   // 0x0020 (32) pixels
0x0000, 0x4A69, 0xFFDF, 0xFFDF, 0xFFDF, 0xFFDF, 0xFFDF, 0xFFDF, 0xFFDF, 0xFFDF, 0xFFDF, 0xFFDF, 0xFFDF, 0x4A69, 0x0000, 0x0000,   // 0x0030 (48) pixels
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0x0000, 0x0000, 0x0000, 0x0000, 0x0000, 0x0000, 0x0000, 0x0000, 0x0000, 0x0000, 0x0000, 0x0000, 0x0000, 0x0000, 0x0000, 0x0000,   // 0x0100 (256) pixels
};

static int16_t PROGMEM icon_motion[] = {
  0x8410, 0x8410, 0x840f, 0x7bf0, 0x840f, 0x83ef, 0x7bb1, 0x7bf0, 0x84ab, 0x8566, 0x85a4, 0x85a4, 0x85a4, 0x85a4, 0x8566, 0x84ab, 0x7bf0, 0x7bb1, 0x83ef, 0x840f, 0x7bf0, 0x840f, 0x8410, 0x8410, 
  0x8410, 0x840f, 0x7bf0, 0x840f, 0x7bf0, 0x7bf0, 0x848b, 0x8566, 0x85a5, 0x85a4, 0x85a4, 0x85c4, 0x85c4, 0x85a4, 0x85a4, 0x85a5, 0x8566, 0x848b, 0x7bf0, 0x7bf0, 0x840f, 0x7bf0, 0x840f, 0x8410, 
  0x840f, 0x7bf0, 0x840f, 0x7bf0, 0x7c2e, 0x8566, 0x85c3, 0x85c4, 0x85c4, 0x85c4, 0x85c4, 0x85c4, 0x85c4, 0x85c4, 0x85c4, 0x85c4, 0x85c4, 0x85c3, 0x8566, 0x7c2e, 0x7bf0, 0x840f, 0x7bf0, 0x840f, 
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  0x8410, 0x8410, 0x840f, 0x7bf0, 0x840f, 0x840f, 0x7bd0, 0x7bd1, 0x842e, 0x84ab, 0x8566, 0x85c4, 0x85c4, 0x8566, 0x84ab, 0x842e, 0x7bd1, 0x7bd0, 0x840f, 0x840f, 0x7bf0, 0x840f, 0x8410, 0x8410
};

// Cấu hình cho giao thức MQTT
const char* clientId = "IvySensor1";
const char* mqttServer = "192.168.1.110";
const int mqttPort = 1883;
// Username và password để kết nối đến MQTT server nếu server có
// bật chế độ xác thực trên MQTT server
// Nếu không dùng thì cứ để vậy
const char* mqttUsername = "<MQTT_BROKER_USERNAME>";
const char* mqttPassword = "<MQTT_BROKER_PASSWORD>";

// MQTT topic để gửi thông tin về nhiệt độ
const char* tempTopic = "/easytech.vn/LivingRoom/Temperature";
// MQTT topic để gửi thông tin về độ ẩm
const char* humidityTopic = "/easytech.vn/LivingRoom/Humidity";
// MQTT topic để gửi thông tin về ánh sáng
const char* lightStatusTopic = "/easytech.vn/LivingRoom/Light";
// MQTT topic để gửi thông tin về chuyển động khi phát hiện
const char* motionTopic = "/easytech.vn/LivingRoom/Motion";

// Khởi tạo thư viện để kết nối wifi và MQTT server
WiFiClient wclient;
PubSubClient client(wclient);

void setup(void)
{
  Serial.begin(115200);

  // Khởi tạo thư viện cho cảm biến DHT
  Wire.begin();
  dht.begin();

  // Set chế độ của chân nối với cảm biến chuyển động là Input
  pinMode(PIR_PIN, INPUT);

  // Do cảm biến chuyển động PIR bị nhiễu khi sử dụng gần Esp8266 nên ta cần
  // phải giảm mức tín hiệu của esp8266 để tránh nhiễu cho PIR
  //WiFi.setPhyMode(WIFI_PHY_MODE_11G); 
  WiFi.setOutputPower(7);

  // Khởi tạo thư viện điều khiển màn hình LCD
  tft.initR(INITR_BLACKTAB);
  tft.setRotation(1);
  clearScreen();
  tft.setTextSize(1);
  tft.setTextColor(ST7735_YELLOW, ST7735_BLACK);
  tft.setCursor(10, 50);
  
  tft.print("Dang ket noi Wifi");

  // Kết nối Wifi và chờ đến khi kết nối thành công
  WiFi.begin(WIFI_SSID, WIFI_PWD);

  int count = 0;
  while (WiFi.status() != WL_CONNECTED) {
    delay(300);
    Serial.print(".");
    tft.print('.');
    count++;

    if (count > 20) {
      ESP.restart();
    }
  }

  tft.print("done!");
  tft.setCursor(10, 80);
  tft.print("IP: ");
  
  tft.print(WiFi.localIP());
  delay(1000);

  clearScreen();
  tft.setCursor(10, 50);  
  tft.print("Dang cap nhat gio tu Internet...");

  // Kết nối tới NTP server dùng UDP để cập nhật thời gian
  Serial.print("Dang cap nhat gio tu Internet...");
  Udp.begin(localPort);
  setSyncProvider(getNtpTime);
  setSyncInterval(300);
  Serial.println("Done");

  tft.print("Done!");

  clearScreen();
  bitmap(19, 87, icon_humidity, 16, 16);
  bitmap(18, 107, icon_temperature, 16, 16);

  // Kết nối tới MQTT server
  client.setServer(mqttServer, mqttPort);
}


void loop() {
  if (!client.connected()) {
    if (client.connect(clientId, mqttUsername, mqttPassword)) {
      Serial.println("Ket noi den MQTT server thanh cong");
      client.loop();
    } else {
      Serial.print("Ket noi den MQTT server that bai. Error code: ");
      Serial.println(client.state());
    }
  } else {
    client.loop();  
  }
  
  updateSensorData();
  
  updateTime();
}

void updateSensorData() {
  // Đối với nhiệt độ, độ ẩm và ánh sáng, ta chỉ update sau một khoảng
  // thời gian nhất định được khai báo trong biến UPDATE_INTERVAL
  unsigned long currentMillis = millis();
  if (lastSensorUpdateTime == 0 || currentMillis - lastSensorUpdateTime >= UPDATE_INTERVAL) {
    Serial.println(); Serial.println();    
    Serial.println("-------------- Cap nhat du lieu cam bien ----------------");
    humidity = dht.readHumidity();
    dtostrf(humidity, 4, 1, humidityMsg);
    Serial.print("Do am la: "); Serial.print(humidityMsg); Serial.println("%");
  
    temperature = dht.readTemperature();
    dtostrf(temperature, 4, 1, temperatureMsg);
    Serial.print("Nhiet do la: "); Serial.print(temperatureMsg); Serial.println("'C");
    
    lightStatus = analogRead(A0)*100/1024;
    dtostrf(lightStatus, 4, 1, lightStatusMsg);
    Serial.print("Do sang la: "); Serial.print(lightStatusMsg); Serial.println("%");

    // Hiển thị dữ liệu ra màn hình LCD

    if (!isnan(temperature) && !isnan(humidity)) {
      tft.setTextSize(2);
  
      tft.setCursor(40, 87);
      tft.setTextColor(ST7735_CYAN, ST7735_BLACK);
  
      tft.print(humidityMsg); tft.print("%");
  
      tft.setCursor(40, 108);
      tft.setTextColor(ST7735_MAGENTA, ST7735_BLACK);
  
      tft.print(temperatureMsg); tft.print("'C");
    }

    // Gửi dữ liệu về server
    client.publish(humidityTopic, humidityMsg);
    delay(100);
    client.publish(tempTopic, temperatureMsg);
    delay(100);
    client.publish(lightStatusTopic, lightStatusMsg);

    lastSensorUpdateTime = currentMillis;
  }

  // Đối với cảm biến chuyển động thì luôn đọc để phát hiện
  // chuyển động tức thời
  boolean currentMotionStatus = digitalRead(PIR_PIN);
  
  if (currentMotionStatus != lastMotionStatus) {
    lastMotionStatus = currentMotionStatus;
    if (currentMotionStatus) {
      Serial.println("Phat hien chuyen dong");
      bitmap2(130, 100, icon_motion, 24, 24);
      client.publish(motionTopic, "1");
    } else {
      Serial.println("Khong con chuyen dong");
      tft.fillRect(130, 100, 24, 24, ST7735_BLACK);
    }    
  }  
}

/*-------- Cập nhật thời gian dùng NTP ----------*/

void updateTime() {
  if (timeStatus() != timeNotSet) {
    if (now() != lastClockUpdateTime) { // Chỉ update nếu thời gian đã thay đổi
      lastClockUpdateTime = now();
      int currentHour = hour();
      int currentMinute = minute();
      int currentSec = second();

      int currentDay = day();
      int currentMonth = month();
      int currentYear = year();
      int weekDay = weekday();
      
      Serial.print("Gio hien tai la ");
      Serial.print(currentHour); Serial.print(":");
      Serial.print(currentMinute); Serial.print(":");
      Serial.print(currentSec); Serial.print(" ");

      Serial.print(currentDay); Serial.print("/");
      Serial.print(currentMonth); Serial.print("/");
      Serial.print(currentYear); Serial.print(" ");

      switch (weekDay)
      {
        case 1: Serial.print(" SUN"); break;
        case 2: Serial.print(" MON"); break;
        case 3: Serial.print(" TUE"); break;
        case 4: Serial.print(" WED"); break;
        case 5: Serial.print(" THU"); break;
        case 6: Serial.print(" FRI"); break;
        case 7: Serial.print(" SAT"); break;
      }

      Serial.println(); Serial.println();

      // Hiển thị ra màn hình LCD
      // current time
      tft.setTextSize(4);
      tft.setTextColor(ST7735_CYAN, ST7735_BLACK);
    
      tft.setCursor(20, 5);
      printTwoDigitsByZero(currentHour);
      tft.setCursor(68, 5);
      tft.print(":");
      tft.setCursor(92, 5);
      printTwoDigitsByZero(currentMinute);
    
      int sx = 21;
      int sy = 40;
      int sec = currentSec*2;
      int black = (60-sec)*2;
      tft.fillRect(sx, sy, sec, 3, ST7735_YELLOW);
      tft.fillRect(sx+sec, sy, black, 3, ST7735_BLACK);

      // current date
      tft.setTextSize(2);
      tft.setTextColor(ST7735_WHITE, ST7735_BLACK);
      tft.setCursor(19, 50);
      tft.print(currentDay);
      tft.print("/");
      tft.print(currentMonth);
      tft.print("/");
      tft.print(currentYear);

      // current week day
      tft.setTextColor(ST7735_WHITE, ST7735_BLACK);
      tft.setCursor(65, 70);
      tft.setTextSize(1);
    
      switch (weekDay)
      {
        case 1: tft.print("      SUN"); break;
        case 2: tft.print("      MON"); break;
        case 3: tft.print("      TUE"); break;
        case 4: tft.print("      WED"); break;
        case 5: tft.print("      THU"); break;
        case 6: tft.print("      FRI"); break;
        case 7: tft.print("      SAT"); break;
      }
    }
  }  
}

const int NTP_PACKET_SIZE = 48; // NTP time is in the first 48 bytes of message
byte packetBuffer[NTP_PACKET_SIZE]; //buffer to hold incoming & outgoing packets

time_t getNtpTime() {
  IPAddress ntpServerIP; // NTP server's ip address

  while (Udp.parsePacket() > 0) ; // discard any previously received packets
  Serial.println("Transmit NTP Request");
  // get a random server from the pool
  WiFi.hostByName(ntpServerName, ntpServerIP);
  Serial.print(ntpServerName);
  Serial.print(": ");
  Serial.println(ntpServerIP);
  sendNTPpacket(ntpServerIP);
  uint32_t beginWait = millis();
  while (millis() - beginWait < 1500) {
    int size = Udp.parsePacket();
    if (size >= NTP_PACKET_SIZE) {
      Serial.println("Receive NTP Response");
      Udp.read(packetBuffer, NTP_PACKET_SIZE);  // read packet into the buffer
      unsigned long secsSince1900;
      // convert four bytes starting at location 40 to a long integer
      secsSince1900 =  (unsigned long)packetBuffer[40] << 24;
      secsSince1900 |= (unsigned long)packetBuffer[41] << 16;
      secsSince1900 |= (unsigned long)packetBuffer[42] << 8;
      secsSince1900 |= (unsigned long)packetBuffer[43];
      return secsSince1900 - 2208988800UL + timeZone * SECS_PER_HOUR;
    }
  }
  Serial.println("No NTP Response :-(");
  return 0; // return 0 if unable to get the time
}

// send an NTP request to the time server at the given address
void sendNTPpacket(IPAddress &address) {
  // set all bytes in the buffer to 0
  memset(packetBuffer, 0, NTP_PACKET_SIZE);
  // Initialize values needed to form NTP request
  // (see URL above for details on the packets)
  packetBuffer[0] = 0b11100011;   // LI, Version, Mode
  packetBuffer[1] = 0;     // Stratum, or type of clock
  packetBuffer[2] = 6;     // Polling Interval
  packetBuffer[3] = 0xEC;  // Peer Clock Precision
  // 8 bytes of zero for Root Delay & Root Dispersion
  packetBuffer[12] = 49;
  packetBuffer[13] = 0x4E;
  packetBuffer[14] = 49;
  packetBuffer[15] = 52;
  // all NTP fields have been given values, now
  // you can send a packet requesting a timestamp:
  Udp.beginPacket(address, 123); //NTP requests are to port 123
  Udp.write(packetBuffer, NTP_PACKET_SIZE);
  Udp.endPacket();
}

/*-------- Hiển thị thông tin ra màn hình LCD ----------*/
void clearScreen() {
  tft.fillScreen(ST7735_BLACK);
  tft.setTextColor(ST7735_WHITE, ST7735_BLACK);
}

void bitmap(int x, int y, int16_t *bitmap, int16_t w, int16_t h) {
  int16_t col, row;
  int16_t offset = 0;
  tft.setAddrWindow(x, y, x+w-1, y+h-1);

  for (row = 0; row < h; row++) {
    for (col = 0; col < w; col++) {
      tft.pushColor(pgm_read_word(bitmap+offset));
      offset++;
    }
  }
}

void bitmap2(int x, int y, int16_t *bitmap, int16_t w, int16_t h) {
  int16_t col, row;
  int16_t offset = 0;
  tft.setAddrWindow(x, y, x+w-1, y+h-1);
  for (row=0; row<h; row++) { // For each scanline...
    for (col=0; col<w; col++) { // For each pixel...
      //To read from Flash Memory, pgm_read_XXX is required.
      //Since image is stored as uint16_t, pgm_read_word is used as it uses 16bit address
      tft.drawPixel(x+col, y+row, pgm_read_word(bitmap + offset));
      offset++;
    } // end pixel
  }
}

bool printTwoDigitsByZero(int digits) {
  if (digits < 10) {
    tft.print("0");
  }

  tft.print(digits);

  return true;
}

